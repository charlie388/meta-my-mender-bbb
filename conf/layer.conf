## conf/layer.conf
```bitbake
# Copyright 2020 Northern.tech AS

# We have a conf and classes directory, add to BBPATH
BBPATH .= ":${LAYERDIR}"

# We have recipes-* directories, add to BBFILES
BBFILES += "${LAYERDIR}/recipes-*/*/*.bb \
            ${LAYERDIR}/recipes-*/*/*.bbappend"

BBFILE_COLLECTIONS += "meta-my-mender-bbb"
BBFILE_PATTERN_meta-my-mender-bbb = "^${LAYERDIR}/"
BBFILE_PRIORITY_meta-my-mender-bbb = "11"

LAYERSERIES_COMPAT_meta-my-mender-bbb = "kirkstone"
```
